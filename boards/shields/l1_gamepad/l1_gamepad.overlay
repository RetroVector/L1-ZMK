#include "l1_gamepad.dtsi" // Notice that the main dtsi files are included in the overlay.

&kscan0 {
    col-gpios
        = <&pro_micro 21 GPIO_ACTIVE_HIGH> // col0
        , <&pro_micro 20 GPIO_ACTIVE_HIGH> // col1
        , <&pro_micro 19 GPIO_ACTIVE_HIGH> // col2
        , <&pro_micro 18 GPIO_ACTIVE_HIGH> // col3
        , <&pro_micro 15 GPIO_ACTIVE_HIGH> // col4
        ;
};